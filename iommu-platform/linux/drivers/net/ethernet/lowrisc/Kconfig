## iommu-platform/linux/drivers/net/ethernet/lowrisc/Kconfig
```kconfig
# SPDX-License-Identifier: GPL-2.0-only
#
# LowRISC/Ariane FPGA Ethernet driver configuration
#

config LOWRISC_ETH
	tristate "LowRISC/Ariane FPGA Ethernet support"
	depends on RISCV && 64BIT && OF
	depends on HAS_IOMEM
	select PHYLIB
	select MDIO_BITBANG
	select CRC32
	help
	  Say Y here if you want to use the gigabit Ethernet MAC of the
	  LowRISC/Ariane FPGA platforms (Genesys II, Nexys Video, ...).

	  The MAC is memory mapped in a 32 KiB AXI window and talks to the on
	  board Realtek RTL8211E-VL PHY through a bit banged MDIO master.

	  To compile this driver as a module, choose M here: the module will be
	  called lowrisc_ethernet.
```
